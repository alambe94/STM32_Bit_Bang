# file: STM32_Bit_Bang_I2C.ioc
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Mcu.Family=STM32F1
Mcu.Name=STM32F103C(8-B)Tx
Mcu.Package=LQFP48
NVIC.PriorityGroup=NVIC_PRIORITYGROUP_4
NVIC.TIM4_IRQn=true\:0\:0\:false\:false\:true\:true\:true
PA13.Mode=Serial_Wire
PA13.Signal=SYS_JTMS-SWDIO
PA14.Mode=Serial_Wire
PA14.Signal=SYS_JTCK-SWCLK
PD0-OSC_IN.Mode=HSE-External-Oscillator
PD0-OSC_IN.Signal=RCC_OSC_IN
PD1-OSC_OUT.Mode=HSE-External-Oscillator
PD1-OSC_OUT.Signal=RCC_OSC_OUT
ProjectManager.HeapSize=0x200
ProjectManager.StackSize=0x400
ProjectManager.TargetToolchain=STM32CubeIDE
RCC.AHBFreq_Value=72000000
RCC.APB1CLKDivider=RCC_HCLK_DIV2
RCC.APB1Freq_Value=36000000
RCC.APB1TimFreq_Value=72000000
RCC.APB2Freq_Value=72000000
RCC.APB2TimFreq_Value=72000000
RCC.HCLKFreq_Value=72000000
RCC.PLLMUL=RCC_PLL_MUL9
RCC.PLLSourceVirtual=RCC_PLLSOURCE_HSE
RCC.SYSCLKFreq_VALUE=72000000
RCC.SYSCLKSource=RCC_SYSCLKSOURCE_PLLCLK
RCC.USBFreq_Value=72000000
TIM4.AutoReloadPreload=TIM_AUTORELOAD_PRELOAD_ENABLE
TIM4.Period=(10-1)
TIM4.Prescaler=(72-1)
VP_TIM4_VS_ClockSourceINT.Mode=Internal
board=custom

// file: Src/main.c
/* USER CODE BEGIN Header */
/**
  ******************************************************************************
  * @file           : main.c
  * @brief          : Main program body
  ******************************************************************************
  * @attention
  *
  * <h2><center>&copy; Copyright (c) 2019 STMicroelectronics.
  * All rights reserved.</center></h2>
  *
  * This software component is licensed by ST under BSD 3-Clause license,
  * the "License"; You may not use this file except in compliance with the
  * License. You may obtain a copy of the License at:
  *                        opensource.org/licenses/BSD-3-Clause
  *
  ******************************************************************************
  */
/* USER CODE END Header */

#include "main.h"
#include "tim.h"
#include "gpio.h"

/* USER CODE BEGIN Includes */
#include "soft_i2c.h"
#include "ssd1306.h"
#include "stdlib.h"

/* USER CODE END Includes */

/* USER CODE BEGIN PV */
Soft_I2C_Master_t OLED_I2C_Handle;
uint8_t I2C1_TX_Buffer[256];
uint8_t I2C1_RX_Buffer[256];

/* USER CODE END PV */

void SystemClock_Config(void);

int main(void)
{

  /* MCU Configuration--------------------------------------------------------*/

  /* Reset of all peripherals, Initializes the Flash interface and the Systick. */
  HAL_Init();

  /* Configure the system clock */
  SystemClock_Config();

  /* Initialize all configured peripherals */
  MX_GPIO_Init();
  MX_TIM4_Init();
  /* USER CODE BEGIN 2 */

  Soft_I2C_Master_Init();

  __HAL_RCC_GPIOA_CLK_ENABLE();

  OLED_I2C_Handle.GPIO_SCL_Pin        = GPIO_PIN_6;
  OLED_I2C_Handle.GPIO_SCL_Port       = GPIOA;
  OLED_I2C_Handle.GPIO_SDA_Pin        = GPIO_PIN_5;
  OLED_I2C_Handle.GPIO_SDA_Port       = GPIOA;

  OLED_I2C_Handle.I2C_TX_Ring_Buffer.Buffer = I2C1_TX_Buffer;
  OLED_I2C_Handle.I2C_RX_Ring_Buffer.Buffer = I2C1_RX_Buffer;

  OLED_I2C_Handle.I2C_TX_Ring_Buffer.Size = 256;
  OLED_I2C_Handle.I2C_RX_Ring_Buffer.Size = 256;

  Soft_I2C_Master_Add(&OLED_I2C_Handle);

  ssd1306_Init();

	ssd1306_Fill(Black);
	ssd1306_UpdateScreen();
	ssd1306_Fill(White);
	ssd1306_UpdateScreen();
	ssd1306_Fill(Black);
	ssd1306_UpdateScreen();
	    ssd1306_WriteString("At:", Font_11x18, White);
	    ssd1306_WriteString("0x", Font_11x18, White);
	ssd1306_UpdateScreen();
/*
    while (1)
	{
	ssd1306_Fill(Black);
	ssd1306_UpdateScreen();
	ssd1306_Fill(White);
	ssd1306_UpdateScreen();
	}
*/
    char temp[5];

    /*********************scan for i2c devices****************************/
    for (uint16_t i = 0; i < 128; i++)
	{
	itoa(i << 1, temp, 16); //int string base 16 (hex)

	Soft_I2C_Master_Scan(&OLED_I2C_Handle, i << 1);
	while (Soft_I2C_Master_Get_Status(&OLED_I2C_Handle) == I2C_Busy);

	if (Soft_I2C_Master_Get_Status(&OLED_I2C_Handle) == I2C_Ok)
	    {
	    ssd1306_SetCursor(0, 30);
	    ssd1306_WriteString("At:", Font_11x18, White);
	    ssd1306_WriteString("0x", Font_11x18, White);
	    ssd1306_WriteString(temp, Font_11x18, White);
	    }
	else
	    {
	    ssd1306_SetCursor(0, 0);
	    ssd1306_WriteString("NO:", Font_11x18, White);
	    ssd1306_WriteString("0x", Font_11x18, White);
	    ssd1306_WriteString(temp, Font_11x18, White);
	    }
	HAL_Delay(1);
	ssd1306_UpdateScreen();
	}

  /* USER CODE END 2 */

  /* Infinite loop */
    while (1)
	{

	}
}

void SystemClock_Config(void)
{
  RCC_OscInitTypeDef RCC_OscInitStruct = {0};
  RCC_ClkInitTypeDef RCC_ClkInitStruct = {0};

  /** Initializes the CPU, AHB and APB busses clocks
  */
  RCC_OscInitStruct.OscillatorType = RCC_OSCILLATORTYPE_HSE;
  RCC_OscInitStruct.HSEState = RCC_HSE_ON;
  RCC_OscInitStruct.HSEPredivValue = RCC_HSE_PREDIV_DIV1;
  RCC_OscInitStruct.HSIState = RCC_HSI_ON;
  RCC_OscInitStruct.PLL.PLLState = RCC_PLL_ON;
  RCC_OscInitStruct.PLL.PLLSource = RCC_PLLSOURCE_HSE;
  RCC_OscInitStruct.PLL.PLLMUL = RCC_PLL_MUL9;
  if (HAL_RCC_OscConfig(&RCC_OscInitStruct) != HAL_OK)
  {
    Error_Handler();
  }
  /** Initializes the CPU, AHB and APB busses clocks
  */
  RCC_ClkInitStruct.ClockType = RCC_CLOCKTYPE_HCLK|RCC_CLOCKTYPE_SYSCLK
                              |RCC_CLOCKTYPE_PCLK1|RCC_CLOCKTYPE_PCLK2;
  RCC_ClkInitStruct.SYSCLKSource = RCC_SYSCLKSOURCE_PLLCLK;
  RCC_ClkInitStruct.AHBCLKDivider = RCC_SYSCLK_DIV1;
  RCC_ClkInitStruct.APB1CLKDivider = RCC_HCLK_DIV2;
  RCC_ClkInitStruct.APB2CLKDivider = RCC_HCLK_DIV1;

  if (HAL_RCC_ClockConfig(&RCC_ClkInitStruct, FLASH_LATENCY_2) != HAL_OK)
  {
    Error_Handler();
  }
}

void Error_Handler(void)
{
}

/************************ (C) COPYRIGHT STMicroelectronics *****END OF FILE****/
